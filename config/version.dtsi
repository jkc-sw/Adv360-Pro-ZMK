#define VERSION_MACRO
macro_ver: macro_ver {
compatible = "zmk,behavior-macro";
label = "macro_ver";
#binding-cells = <0>;
bindings = <&kp N2>, <&kp N0>, <&kp N2>, <&kp N3>, <&kp N1>, <&kp N2>, <&kp N3>, <&kp N0>, <&kp MINUS>, <&kp M>, <&kp Y>, <&kp V>, <&kp N3>, <&kp MINUS>, <&kp N1>, <&kp N7>, <&kp N2>, <&kp N8>, <&kp A>, <&kp N6>, <&kp N6>, <&kp RET>;
};
